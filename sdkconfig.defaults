## sdkconfig.defaults
```kconfig
# ESP32-S3, 8 MB flash, PSRAM octal (dùng cho cả XIAO Sense và board OV5640)
CONFIG_IDF_TARGET="esp32s3"
CONFIG_ESPTOOLPY_FLASHSIZE_8MB=y
CONFIG_ESPTOOLPY_FLASHMODE_DIO=y
CONFIG_ESPTOOLPY_FLASHFREQ_80M=y
CONFIG_PARTITION_TABLE_SINGLE_APP_LARGE=y

CONFIG_SPIRAM=y
CONFIG_SPIRAM_MODE_OCT=y
CONFIG_SPIRAM_SPEED_80M=y
CONFIG_SPIRAM_USE_MALLOC=y

# Hiệu năng
CONFIG_ESP_DEFAULT_CPU_FREQ_MHZ_240=y
CONFIG_COMPILER_OPTIMIZATION_PERF=y
CONFIG_FREERTOS_HZ=1000

# Wi-Fi thông lượng cao
CONFIG_ESP_WIFI_STATIC_RX_BUFFER_NUM=16
CONFIG_ESP_WIFI_DYNAMIC_RX_BUFFER_NUM=64
CONFIG_ESP_WIFI_DYNAMIC_TX_BUFFER_NUM=64
CONFIG_ESP_WIFI_AMPDU_TX_ENABLED=y
CONFIG_ESP_WIFI_TX_BA_WIN=32
CONFIG_ESP_WIFI_AMPDU_RX_ENABLED=y
CONFIG_ESP_WIFI_RX_BA_WIN=32
CONFIG_ESP_WIFI_IRAM_OPT=y
CONFIG_ESP_WIFI_RX_IRAM_OPT=y
CONFIG_LWIP_IRAM_OPTIMIZATION=y
CONFIG_LWIP_TCP_SND_BUF_DEFAULT=32768
CONFIG_LWIP_TCP_WND_DEFAULT=16384
CONFIG_LWIP_TCP_RECVMBOX_SIZE=32
CONFIG_LWIP_TCPIP_RECVMBOX_SIZE=64

# Camera: hỗ trợ cả OV5640 và OV2640, buffer JPEG đủ cho SVGA
CONFIG_OV5640_SUPPORT=y
CONFIG_OV2640_SUPPORT=y
CONFIG_CAMERA_CORE1=y
CONFIG_CAMERA_JPEG_MODE_FRAME_SIZE_CUSTOM=y
CONFIG_CAMERA_JPEG_MODE_FRAME_SIZE=131072

# Header trình duyệt dài
CONFIG_HTTPD_MAX_REQ_HDR_LEN=1024
```
